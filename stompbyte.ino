#include "PCM.h"

const unsigned char deadkick[] PROGMEM = {
126, 125, 128, 124, 128, 124, 128, 122, 120, 118, 118, 112,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 128
};

const unsigned char electrokick[] PROGMEM = {
124, 126, 128, 126, 130, 151, 82, 166, 120, 92, 155, 106,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 128
};

const unsigned char kick808[] PROGMEM = {
126, 128, 126, 126, 126, 126, 126, 126, 126, 128, 126, 128,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 126
};

const unsigned char clave[] PROGMEM = {
140, 71, 149, 220, 4, 129, 248, 54, 57, 237, 141, 0,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 126
};

const unsigned char sticks[] PROGMEM = {
148, 112, 110, 155, 108, 134, 142, 69, 117, 215, 108, 140,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 126
};

const unsigned char tambourine[] PROGMEM = {
125, 126, 125, 126, 125, 126, 125, 125, 129, 123, 130, 121,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 128
};

const unsigned char handclap[] PROGMEM = {
124, 128, 114, 124, 122, 141, 133, 131, 126, 114, 192, 83,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 126
};

const unsigned char smb_bump[] PROGMEM = {
126, 128, 126, 128, 126, 128, 126, 128, 126, 128, 126, 128,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 128
};

const unsigned char smb_fireball[] PROGMEM = {
126, 128, 126, 128, 126, 126, 128, 128, 231, 255, 240, 242,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 128
};

const unsigned char smb_jumpsm[] PROGMEM = {
126, 128, 126, 128, 126, 128, 126, 128, 126, 128, 126, 128,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 126
};


const unsigned long debounceTime = 50;
const unsigned long holdSelectTime = 2000;
const int stompPin = 8;

int kickStyle = 0;
int stompState = 0;
int patternStep = 0;
unsigned long stompTime;

void playKick() {
  stopPlayback();
  if (kickStyle==0) {
    startPlayback(deadkick, sizeof(deadkick));
  }
  if (kickStyle==1) {
    startPlayback(electrokick, sizeof(electrokick));
  }
  if (kickStyle==2) {
    startPlayback(kick808, sizeof(kick808));
  }
  if (kickStyle==3) {
    startPlayback(clave, sizeof(clave));
  }
  if (kickStyle==4) {
    startPlayback(sticks, sizeof(sticks));
  }
  if (kickStyle==5) {
    startPlayback(tambourine, sizeof(tambourine));
  }
  if (kickStyle==6) {
    startPlayback(handclap, sizeof(handclap));
  }
  if (kickStyle==7) {
    startPlayback(smb_bump, sizeof(smb_bump));
  }
  if (kickStyle==8) {
    startPlayback(smb_fireball, sizeof(smb_fireball));
  }
  if (kickStyle==9) {
    startPlayback(smb_jumpsm, sizeof(smb_jumpsm));
  }
}

void playPattern() {
  if (kickStyle==10) {
    if (patternStep==0) {
      startPlayback(deadkick, sizeof(deadkick));
    }
    if ((patternStep==1) || (patternStep==3)) {
      startPlayback(clave, sizeof(clave));
    }
    if (patternStep==2) {
      startPlayback(tambourine, sizeof(tambourine));
    }
  }
  if (kickStyle==11) {
    if (patternStep==0) {
      startPlayback(kick808, sizeof(kick808));
    }
    if ((patternStep==1) || (patternStep==3)) {
      startPlayback(tambourine, sizeof(tambourine));
    }
    if (patternStep==2) {
      startPlayback(handclap, sizeof(handclap));
    }
  }
  if (kickStyle==12) {
    if (patternStep==0) {
      startPlayback(smb_bump, sizeof(smb_bump));
    }
    if ((patternStep==1) || (patternStep==3)) {
      startPlayback(smb_fireball, sizeof(smb_fireball));
    }
    if (patternStep==2) {
      startPlayback(smb_jumpsm, sizeof(smb_jumpsm));
    }
  }
  if (++patternStep > 3) {
    patternStep=0;
  }
}

void previewPattern() {
  patternStep=0;
  do {
    playPattern();
    delay(300);
  } while (patternStep < 3);
  patternStep=0;
}

void setup() {
  stompTime=millis();
  pinMode(stompPin, INPUT_PULLUP);
}

void loop() {
  int val=digitalRead(stompPin);

  // play a sound 
  if ((val != stompState) && (millis()-stompTime > debounceTime)) {
    stompState=val;
    if (kickStyle < 10) {
      if (stompState == LOW) {
        playKick();
      }
    } else {
      playPattern();
    }
    stompTime=millis();
  }

  // select sound/pattern
  if ((stompState == LOW) && (millis()-stompTime > holdSelectTime)) {
    if (++kickStyle > 12) {
      kickStyle=0;
    }
    if (kickStyle < 10) {
      playKick();
    } else {
      previewPattern();
    }
    while (digitalRead(stompPin) == LOW) {
    }
    stompState=HIGH;
    stompTime=millis();
  }
}
